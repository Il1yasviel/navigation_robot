## components/config/Kconfig.projbuild
```kconfig
menu "Navigation robot configuration"

config ROBOT_HOST_UART_NUM
    int "FTDI host UART number"
    default 0
    range 0 2

config ROBOT_HOST_UART_TX_GPIO
    int "FTDI host UART TX GPIO"
    default 43

config ROBOT_HOST_UART_RX_GPIO
    int "FTDI host UART RX GPIO"
    default 44

config ROBOT_MOTOR_UART_NUM
    int "M0601 RS485 UART number"
    default 1
    range 0 2

config ROBOT_RS485_TX_GPIO
    int "RS485 TX/DI GPIO"
    default 17

config ROBOT_RS485_RX_GPIO
    int "RS485 RX/RO GPIO"
    default 18

config ROBOT_DEFAULT_MOTOR_ID
    int "Fallback M0601 motor ID"
    default 1
    range 0 255

config ROBOT_TEST_MAX_RPM
    int "Application motor speed limit (RPM)"
    default 125
    range 1 330

config ROBOT_LEFT_MOTOR_ID
    int "Left M0601 motor ID"
    default 1
    range 0 255

config ROBOT_RIGHT_MOTOR_ID
    int "Right M0601 motor ID"
    default 2
    range 0 255

config ROBOT_WIFI_ENABLED
    bool "Enable Wi-Fi STA and TCP host link"
    default y

config ROBOT_WIFI_SSID
    string "Wi-Fi STA SSID"
    default ""
    depends on ROBOT_WIFI_ENABLED

config ROBOT_WIFI_PASSWORD
    string "Wi-Fi STA password"
    default ""
    depends on ROBOT_WIFI_ENABLED

config ROBOT_WIFI_TCP_PORT
    int "Host protocol TCP port"
    default 3333
    range 1 65535
    depends on ROBOT_WIFI_ENABLED

config ROBOT_WIFI_HOSTNAME
    string "mDNS hostname"
    default "navigation-robot"
    depends on ROBOT_WIFI_ENABLED

config ROBOT_CONTROL_WATCHDOG_MS
    int "Host control watchdog (ms)"
    default 300
    range 100 5000

config ROBOT_TELEMETRY_PERIOD_MS
    int "Heartbeat period (ms)"
    default 100
    range 20 5000

config ROBOT_MOTOR_TIMEOUT_MS
    int "M0601 transaction timeout (ms)"
    default 80
    range 10 1000

endmenu
```

## navigation_robot/sdkconfig.defaults
```kconfig
CONFIG_ESPTOOLPY_FLASHSIZE_16MB=y
CONFIG_SPIRAM=y
CONFIG_SPIRAM_MODE_OCT=y
CONFIG_BOOTLOADER_LOG_LEVEL_NONE=y
CONFIG_ESP_CONSOLE_NONE=y
CONFIG_ESP_CONSOLE_SECONDARY_NONE=y
CONFIG_LOG_DEFAULT_LEVEL_NONE=y
```
